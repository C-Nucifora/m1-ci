VERSION ""

NS_ :

BS_:

BU_: ECU

BO_ 1021 Status: 8 ECU
 SG_ Yaw_Rate : 0|16@1- (0.5,-100) [0|0] "°/s" Vector__XXX
 SG_ Ready : 10|1@1+ (1,0) [0|0] "" Vector__XXX
